#include "timer.h"
#include "sys.h"
#include "usart.h"		
#include "delay.h"	
#include "adc.h"
#include "utility.h"
#include "stratagy.h"
#include "led.h"
#include "stmflash.h"

u8 LastSearchAction=Stright;
int turnrighto,turnlefto;
int turno=0;
u8 spurt_45_end_flag=0;
extern u8 spurtTestFlag;
extern u8 ObjectGoTo_Flag;
extern u8 BackSearchFlag;
u8 spurt_action_num=0;
u8 afterturn_flag=0;
u8 goal_keep_flag=0;
u8 back90_flag=0;
extern u8 block_write_flag;
extern float SPURT90IR_kp1,SPURT90IR_kp2,SPURT90IR_kd,SPURT90GYRO_kp,SPURT90GYRO_kd;

extern uchar	Mapfastway[MAZETYPE][MAZETYPE]      ;

uchar actionsequence[200]={0};//200！一定要改回来！
uchar action_correct_sequence[200]={0};//200！一定要改回来！

extern char GoalX;
extern char GoalY;
extern u8 GoOrBackFlag;

extern uchar    GucXGoal0;            /*  终点X坐标，有两个值         */
extern uchar    GucXGoal1;
extern uchar    GucYGoal0;            /*  终点Y坐标，有两个值         */
extern uchar    GucYGoal1;

extern MAZECOOR GmcMouse; 
extern  uchar    GucMouseTask;
extern u8 goaheadnum;
extern uchar	FastwayCount_90;
extern uchar	Mapfastway_90[MAZETYPE][MAZETYPE];
extern FASTWAYACTION	FastwayAction_90[MAZETYPE * MAZETYPE];//={0,0,1,1,1,0,7};              /*  在mapStepEdit()中作堆栈使用 */


//搜索速度
//#define search_speed_30
// #define search_speed_50
 #define  search_speed_70
// #if goaheadnum==2
// #define search_speed_30
// #endif
// #if goaheadnum==3
// #define search_speed_50
// #endif
//只写入需要调试的变量，以防每次写入程序用过多时间
//低速数据18K，中速K，高速K
#define LOW_90_ENABLE //垂直冲刺 2014年10月10日新增
#define LOW_ENABLE	//低速 所有转弯和直线都90
#define MEDIUM_ENABLE //中速 90t,180t,45v--110; 45t,90v,135t,135v---90; 直线斜线均90(最高150)
//#define HIGH_ENABLE

extern u8 blocknum;
extern u8 task,sleepmode;
extern u8 flashwrite;
extern u16 tick;
extern u8 step;
extern long e,eh,esum;
extern int speedl,speedr,speed;
extern long disf1,disf2,disf,disl,disr;
extern long dislh,disrh,dislhh,disrhh,disl45h,disr45h,disl45hh,disr45hh;
extern u16 disl45,disr45;
extern long leftb,rightb,leftbh,rightbh,loopahead,absoluteangle,baseangle,angle;
extern long gangleh,ganglehh,peakgangle,peakgangleh;
extern long leftd,rightd,leftdh,rightdh,leftcycle,rightcycle,absolutetrack,absolutetrackl,absolutetrackr,basetrack,basetrackl,basetrackr,trackl,trackr,track;
extern int setvl,setvr;
extern u8 dis2wall;
extern int ganglet,gangle;
extern u16 gangleratio;
extern u16 speed_ss,speed_turn,speed_fastss;
extern u8 lefthaswall,righthaswall,forwardhaswall,lefthaswallh,righthaswallh,lefthaswall45,righthaswall45,lefthaswallh45,righthaswallh45,leftwallcriticalhhh,rightwallcriticalhhh;;
extern u8 leftwallcritical,rightwallcritical,leftwallcriticalh,rightwallcriticalh,leftwallcriticalhh,rightwallcriticalhh;
extern u8 irswitch;
extern u16 turnaround_tick;
extern u16 flashaddr,flashaddrmax;
extern u8 sidewall_threshold;

extern MAZECOOR GmcMouse;                                               /*  GmcMouse.x :电脑鼠横坐标    */
extern u8 task;                                                                        /*  GmcMouse.y :电脑鼠纵坐标    */
                                                                        
extern uchar    GucMouseDir;                                            /*  电脑鼠的前进方向            */
extern uchar    GucMapBlock[MAZETYPE][MAZETYPE];                        /*  GucMapBlock[x][y]           */
                                                                        /*  x,横坐标;y,纵坐标;          */
                                                                       /*  bit3~bit0分别代表左下右上   */
                                                                       /*  0:该方向无路，1:该方向有路  */
extern uchar	GucMapGet[MAZETYPE][MAZETYPE];

//冲刺
extern FASTWAYACTION FastwayAction[MAZETYPE * MAZETYPE];              /*  在mapStepEdit()中作堆栈使用 */
extern uchar	FastwayCount;

extern const short *turn_gyro,*turn_vl,*turn_vr;//下面的数组加const前缀就会保存到flash里，而不是sram（相当于内存）里。而const数组必须用const指针调用
extern u16 dislpeak,disrpeak;
u8 lpeakfindenable,rpeakfindenable;
extern u16 leftpeaktrack,rightpeaktrack;
u8 goaheadbugflag=0;
extern u8 EMERGENCYON;
extern u16 isemergency;
u8 speedmode;
extern u8 kalmanswitch;

extern u16 speed_ss;
extern u16 speed_turn;
extern u16 speed_fastss;	
extern double GOSTRAIGHT_kp;
extern double SMARTSTRAIGHTFAST_bigerror_kp;
extern double SMARTSTRAIGHTFAST_smallerror_kp;
extern double STRAIGHT45_kp,STRAIGHT45_kd;
extern double turn_kp,turn_kd;
//=================================新增，要查明用途===================
//extern char GoalX,GoalY;
extern int stoptick;
//int adjflag;

//---------------------------------------垂直冲刺90度弯--------------------------
 const short gyro_l_spurt[193]={90,90,90,90,90,90,90,90,90,90,90,90,90,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0,0};
 const short gyro_r_spurt[193]={-90,-90,-90,-90,-90,-90,-90,-90,-90,-90,-90,-90,-90,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0,0};
 const short vouter_spurt[193]={70,70,70,70,70,70,70,70,70,70,70,71,72,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70,70};
 const short vinner_spurt[193]={70,70,70,70,70,70,70,70,70,70,70,69,68,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70,70};

#ifdef search_speed_30
//const short gyro_l_search[370]={0,0,0,0,0,0,0,0,0,0,0,0,0,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0,0};
//const short gyro_r_search[370]={0,0,0,0,0,0,0,0,0,0,0,0,0,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0,0};
//const short vouter_search[370]={30,30,30,31,31,31,31,31,32,32,32,32,32,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30,30};
//const short vinner_search[370]={30,30,30,29,29,29,29,29,28,28,28,28,28,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30,30};
//// //搜索回转180度。若修改turn around的数组长度，记得同时修改timer.c里的tick值！！
//// const short gyro_around[243]={};
//// const short vl_around[243]={};
//// const short vr_around[243]={};
//// //原地转90度 若修改数组长度，记得同时修改timer.c里的tick值！！
//// //const short gyro_l_point[182]={90,90,90,90,90,90,90,90,90,90,90,90,90,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0,0};
//// //const short gyro_r_point[182]={-90,-90,-90,-90,-90,-90,-90,-90,-90,-90,-90,-90,-90,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0,0};
//// const short gyro_l_point[182]={};
//// const short gyro_r_point[182]={};
//// const short vouter_point[182]={};
//// const short vinner_point[182]={};
#endif	
	 
//	之前的轮距70mm
#ifdef search_speed_50
const short gyro_l_search[222]={90,90,90,90,90,90,90,90,90,90,89,89,89,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0,0};
const short gyro_r_search[222]={-90,-90,-90,-90,-90,-90,-90,-90,-90,-90,-89,-89,-89,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0,0};
const short vouter_search[222]={51,51,52,52,53,53,54,54,55,55,56,56,57,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50,50};
const short vinner_search[222]={49,49,48,48,47,47,46,46,45,45,44,44,43,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50,50};	
#endif

//	搜索转90度  70cm/s
#ifdef search_speed_70
	//old
const short gyro_l_search[216]={90,90,90,90,90,90,90,90,90,90,90,90,90,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0,0};
const short gyro_r_search[216]={-90,-90,-90,-90,-90,-90,-90,-90,-90,-90,-90,-90,-90,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0,0};
const short vouter_search[216]={70,70,71,71,72,72,73,73,74,74,75,75,76,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70,70};
const short vinner_search[216]={70,70,68,67,65,64,62,61,59,58,56,55,53,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70,70};

	
	//new
// const short gyro_l_search[198]={90,90,90,90,90,90,90,90,90,90,90,90,90,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0,0};
// const short gyro_r_search[198]={-90,-90,-90,-90,-90,-90,-90,-90,-90,-90,-90,-90,-90,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0,0};
// const short vouter_search[198]={70,71,71,72,72,73,74,74,75,75,76,77,77,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70,70};
// const short vinner_search[198]={70,69,68,68,67,66,65,64,63,63,62,61,60,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70,70};

#endif

//	搜索回转180度 若修改turn around的数组长度，记得同时修改timer.c里的tick值！！
const short gyro_around[267]={-180,-180,-180,-180,-180,-180,-180,-180,-180,-180,-180,-180,-180,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0,0};
//const short vl_around[267]={0,0,1,2,2,3,4,5,6,6,7,8,9,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0,0};
//const short vr_around[267]={0,0,-1,-2,-2,-3,-4,-5,-6,-6,-7,-8,-9,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0,0};
const short vl_around[267]={0, 0, 1, 2, 2, 3, 4, 5, 6, 6, 8, 9, 10,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 0, 0};
const short vr_around[267]={0, 0, -1, -2, -2, -3, -4, -5, -6, -6, -8, -9, -10,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 0, 0};
//	原地转90度 若修改数组长度，记得同时修改timer.c里的tick值！！
const short gyro_l_point[232]={90,90,90,90,90,90,90,90,90,90,90,90,90,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0,0};
const short gyro_r_point[232]={-90,-90,-90,-90,-90,-90,-90,-90,-90,-90,-90,-90,-90,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0,0};
//const short vouter_point[232]={0,0,1,1,2,3,3,4,4,5,6,6,7,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0,0};
//const short vinner_point[232]={0,0,-1,-1,-2,-3,-3,-4,-4,-5,-6,-6,-7,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0,0};
const short vouter_point[232]={0, 0, 1, 1, 2, 3, 3, 4, 4, 5, 6, 6, 8,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 0, 0};
const short vinner_point[232]={0, 0, -1, -1, -2, -3, -3, -4, -4, -5, -6, -6, -8,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 0, 0};
	
#ifdef LOW_ENABLE
	
//90t度，出入点距离柱子中间距离30mm  xbase=9 ybase=15
//const short gyro_lt90_low[206]={90,90,90,90,90,90,90,90,90,90,90,90,90,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0,0};
//const short gyro_rt90_low[206]={-90,-90,-90,-90,-90,-90,-90,-90,-90,-90,-90,-90,-90,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0,0};
//const short vouter_t90_low[206]={100,100,101,101,101,102,102,102,103,103,103,103,104,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100,100};
//const short vinner_t90_low[206]={100,99,98,98,97,96,95,94,93,93,92,91,90,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100,100};

const short gyro_lt90_low[216]={90,90,90,90,90,90,90,90,90,90,90,90,90,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0,0};
const short gyro_rt90_low[216]={-90,-90,-90,-90,-90,-90,-90,-90,-90,-90,-90,-90,-90,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0,0};
const short vouter_t90_low[216]={70,70,71,71,72,72,73,73,74,74,75,75,76,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70,70};
const short vinner_t90_low[216]={70,70,68,67,65,64,62,61,59,58,56,55,53,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70,70};

	
//90v度V转弯，出入点x,y坐标距离分界线都是20mm，斜线距离28mm xbase=11 ybase=20
const short gyro_lv90_low[187]={90,90,90,90,90,90,90,90,90,90,90,90,90,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0,0};
const short gyro_rv90_low[187]={-90,-90,-90,-90,-90,-90,-90,-90,-90,-90,-90,-90,-90,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0,0};
const short vouter_v90_low[187]={100,100,100,100,100,100,100,100,100,100,100,100,100,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100,100};
const short vinner_v90_low[187]={100,99,97,96,95,93,92,91,89,88,87,85,84,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100,100};

//45t度有正转斜，入点距离柱子中间45mm  xbase=9 ybase=13.5
const short gyro_lt45_low[152]={45,45,45,45,45,45,45,45,45,45,45,45,45,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0,0};
const short gyro_rt45_low[152]={-45,-45,-45,-45,-45,-45,-45,-45,-45,-45,-45,-45,-45,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0,0};
const short vouter_t45_low[152]={100,100,100,101,101,101,101,102,102,102,102,103,103,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100,100};
const short vinner_t45_low[152]={100,97,93,90,86,83,79,76,72,69,66,62,59,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100,100};

//45v度由斜转正，入点x,y坐标都是20mm，斜线距离28mm  xbase=11 ybase=20
const short gyro_lv45_low[171]={45,45,45,45,45,45,45,45,45,45,45,45,45,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0,0};
const short gyro_rv45_low[171]={-45,-45,-45,-45,-45,-45,-45,-45,-45,-45,-45,-45,-45,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0,0};
const short vouter_v45_low[171]={100,100,100,99,99,99,99,99,99,98,98,98,98,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100,100};
const short vinner_v45_low[171]={100,100,100,99,99,99,99,99,99,98,98,98,98,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100,100};

//135t度有正转斜，出入点距离柱子中间距离30mm	 xbase=9 ybase=15
const short gyro_lt135_low[302]={135,135,135,135,135,135,135,135,135,135,135,135,135,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0,0};
const short gyro_rt135_low[302]={-135,-135,-135,-135,-135,-135,-135,-135,-135,-135,-135,-135,-135,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0,0};
const short vouter_t135_low[302]={100,100,100,100,100,100,100,100,100,100,100,100,100,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100,100};
const short vinner_t135_low[302]={100,99,98,98,97,96,95,94,93,93,92,91,90,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100,100};

//135v度由斜转正，入点x,y坐标都是20mm，斜线距离28mm	xbase=11 ybase=20
const short gyro_lv135_low[294]={135,135,135,135,135,135,135,135,135,135,135,135,135,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0,0};
const short gyro_rv135_low[294]={-135,-135,-135,-135,-135,-135,-135,-135,-135,-135,-135,-135,-135,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0,0};
const short vouter_v135_low[294]={100,100,100,100,100,100,100,100,100,99,99,99,99,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100,100};
const short vinner_v135_low[294]={100,99,99,98,97,96,96,95,94,94,93,92,91,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100,100};

//180度  xbase=9 ybase=15
const short gyro_l180_low[329]={180,180,180,180,180,180,180,180,180,180,180,180,180,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1,1};
const short gyro_r180_low[329]={-180,-180,-180,-180,-180,-180,-180,-180,-180,-180,-180,-180,-180,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-1,-1};
const short vouter_180_low[329]={100,101,102,103,104,105,106,107,109,110,111,112,113,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101,100};
const short vinner_180_low[329]={100,99,98,97,96,95,94,93,91,90,89,88,87,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99,100};

#endif

/*********************************************************************************************************
** Function name:       __mouseCoorUpdate
** Descriptions:        根据当前方向更新坐标值
** input parameters:    无
** output parameters:   无
** Returned value:      无
*********************************************************************************************************/
u8 test=0;
void __mouseCoorUpdate (void)
{	//if(test==0){ledoff(5);ledon(4);test=1;}else {ledoff(4);ledon(5);test=0;}
    switch (GucMouseDir) {

    case 0:
        GmcMouse.cY++;
        break;

    case 1:
        GmcMouse.cX++;
        break;

    case 2:
        GmcMouse.cY--;
        break;

    case 3:
        GmcMouse.cX--;
        break;

    default:
        break;
    }
// 		ShowMouseXY();
	//send(GmcMouse.cX);send(GmcMouse.cY);
    __wallCheck();
	//send(GucMapBlock[GmcMouse.cX][GmcMouse.cY]);
}

/*********************************************************************************************************
** Function name:       __mouseCoorUpdate_Fast
** Descriptions:        Object_Go_To高速返回的坐标更新,不更新墙壁信息。
** input parameters:    无
** output parameters:   无
** Returned value:      无
*********************************************************************************************************/
void __mouseCoorUpdate_Fast (u8 num)
{	//if(test==0){ledoff(5);ledon(4);test=1;}else {ledoff(4);ledon(5);test=0;}
    switch (GucMouseDir) {

    case 0:
        GmcMouse.cY+=num;
        break;

    case 1:
        GmcMouse.cX+=num;
        break;

    case 2:
        GmcMouse.cY-=num;
        break;

    case 3:
        GmcMouse.cX-=num;
        break;

    default:
        break;
    }
// 		ShowMouseXY();
	//send(GmcMouse.cX);send(GmcMouse.cY);
    __wallCheck();
	//send(GucMapBlock[GmcMouse.cX][GmcMouse.cY]);
}

/*********************************************************************************************************
** Function name:       __wallCheck
** Descriptions:        根据传感器检测结果判断是否存在墙壁
** input parameters:    无
** output parameters:   无
** Returned value:      cValue: 低三位从左到右一次代表左前右。1为有墙，0为没墙。
*********************************************************************************************************/
void __wallCheck (void)
{
    uchar ucMap = 0;
	uchar temp,temp1;
    /*    
      用绝对方向来表示相对方向上的资料表位置
#define MOUSEWAY_F          (1 <<   GucMouseDir)            若 GucMouseDir=UP=0  0000 0001  左移    GucMouseDir 位            0000 0001
#define MOUSEWAY_R          (1 << ((GucMouseDir + 1) % 4))                       0000 0001  左移    （GucMouseDir+1)% 4 位    0000 0010
#define MOUSEWAY_B          (1 << ((GucMouseDir + 2) % 4))                       0000 0001  左移    (GucMouseDir + 2) % 4 位  0000 0100 
#define MOUSEWAY_L          (1 << ((GucMouseDir + 3) % 4))                       0000 0001  左移    (GucMouseDir + 3) % 4 位  0000 1000
#define UP                  0
#define RIGHT               1
#define DOWN                2
#define LEFT                3
bit3~bit0分别代表 左 下 右 上              0:该方向无路，1:该方向有路       0是有墙，1是没有墙    */  
	
    GucMapGet[GmcMouse.cX][GmcMouse.cY]=1;
    
    ucMap |= MOUSEWAY_B;                               
    if (lefthaswall==1) {                
        ucMap &= ~MOUSEWAY_L;                          
    }else {
        ucMap |=  MOUSEWAY_L;                        
    }
    if (forwardhaswall==1) {
        ucMap &= ~MOUSEWAY_F;                          
    }else {
        ucMap |=  MOUSEWAY_F;                         
    }
    if (righthaswall==1) {
        ucMap &= ~MOUSEWAY_R;                          
    }else {
        ucMap |=  MOUSEWAY_R;                         
    }
	ucMap=(ucMap&0x0F);
    temp1 = ucMap;                    //  低四位   和   高四位   一样
	temp=(temp1<<4);
	ucMap=(ucMap|temp);
                                                      //初始时 认为低四位=0 "有墙"   高四位=f  认为"没有墙"   
    if ((GucMapBlock[GmcMouse.cX][GmcMouse.cY]&0x0f) == 0x00) 
    {                 
        GucMapBlock[GmcMouse.cX][GmcMouse.cY] = ucMap; 
	        
	    if( GmcMouse.cX >0 )
	    {
	         if( (GucMapBlock[GmcMouse.cX][GmcMouse.cY]&0x08) == 0x00 )                //左 下 右 上 1101 1111   1111 0111             
	         {
	          GucMapBlock[GmcMouse.cX-1][GmcMouse.cY]=((GucMapBlock[GmcMouse.cX-1][GmcMouse.cY])&0xdf);                          
	         }
	     }
	        
	    if( GmcMouse.cX < MAZETYPE-1 )
	    {   if( (GucMapBlock[GmcMouse.cX][GmcMouse.cY]&0x02) == 0x00 )                  //   0111 1111      1111 1101      
	        {
	          GucMapBlock[GmcMouse.cX+1][GmcMouse.cY]=((GucMapBlock[GmcMouse.cX+1][GmcMouse.cY])&0x7f);                          
	        }
	    }   
	    
	    if( GmcMouse.cY >0 )    
	    {       if( (GucMapBlock[GmcMouse.cX][GmcMouse.cY]&0x04) == 0x00 )                 //1110 1111   1111 1011
	        {
	          GucMapBlock[GmcMouse.cX][GmcMouse.cY-1]=((GucMapBlock[GmcMouse.cX][GmcMouse.cY-1])&0xef);                          
	        }
	    }
	    
	    if( GmcMouse.cY < MAZETYPE-1 ) 
	    {   
			if( (GucMapBlock[GmcMouse.cX][GmcMouse.cY]&0x01) == 0x00 )                  //1011 1111 1111 1110
	        {
	          GucMapBlock[GmcMouse.cX][GmcMouse.cY+1]=((GucMapBlock[GmcMouse.cX][GmcMouse.cY+1])&0xbf);                          
	        } 
	    }
    }       
}

u8 breakornot()//判断是否需要跳出执行算法
{
	if(forwardhaswall==1)return 1;
	else if(lefthaswall==0)return 1;
	else if(righthaswall==0)return 1;
	else return 0;
}

u8 keyCheck()
{
	delay_ms(1000);
	return 1;
}

int abovezero(int t)
{
	if(t>=0)return t;
	else return 0;
}

void settrack(int t)//修正相对坐标
{
	basetrack=absolutetrack-t;
	track=t;
}

void setangle(int a)//把角度基准逆时针(-)或顺时针(+)转几度
{
	ganglet=-a*gangleratio;
	baseangle=absoluteangle+a; 	
}

////////////////////////////////////////////////////////////////////////////////////////
u16 accdistance=40;
extern double accratio;
void taskacc()
{
	settrack(0);
	e=0;eh=0;
 	accratio=(double)(speed_turn-ACCV0)/accdistance;//10是初始阶跃速度
	while(track<accdistance) task=ACC;
}

extern double decratio;
u16 decdistance=40;
void taskstop()
{
	settrack(-decdistance);
	eh=0;
	e=0;
	tick=0;
	stoptick=0;
	decratio=(double)speed/decdistance;	
	while(tick<5)
	{
		task=STOP;
		if(stoptick>1000) break;//1s超时
	}
	settrack(0);
}

void taskgostraight(u16 dis)
{
	eh=0;
	e=0;
	while(track<dis) task=GOSTRAIGHT;
}

void taskslowdown(u16 dis)
{
	long begintrack;
	e=0;eh=0;tick=0;
	begintrack=absolutetrack;
	while(speed>speed_turn && absolutetrack-begintrack<dis) task=SLOWDOWN;
	while(absolutetrack-begintrack<dis) task=GOSTRAIGHT;
}

void taskspeedup(u16 dis)
{
	long begintrack;
	e=0;eh=0;tick=0;
	begintrack=absolutetrack;
	while(speed<speed_ss && absolutetrack-begintrack<dis) task=SPEEDUP;
	while(absolutetrack-begintrack<dis)
	{
		setvl=speed_ss;
		setvr=speed_ss;
	}
}

void taskturn(u8 pattern)
{
	u16 length;
	eh=0;
	e=0;
	esum=0;
	tick=0;		
	switch(pattern)
	{
		case LT90SPURT:
			setangle(-90);
			turn_gyro=gyro_l_spurt;turn_vl=vinner_spurt;turn_vr=vouter_spurt;
			length=sizeof(gyro_l_spurt);
			break;
		case RT90SPURT:
			setangle(90);
			turn_gyro=gyro_r_spurt;turn_vl=vouter_spurt;turn_vr=vinner_spurt;
			length=sizeof(gyro_r_spurt);	
			break;
		case LT90SEARCH:
			setangle(-90);
			turn_gyro=gyro_l_search;turn_vl=vinner_search;turn_vr=vouter_search;
			length=sizeof(gyro_l_search);
			break;
		case RT90SEARCH:
			setangle(90);
			turn_gyro=gyro_r_search;turn_vl=vouter_search;turn_vr=vinner_search;
			length=sizeof(gyro_r_search);	
			break;
		case POINTL90:
			setangle(-90);
			turn_gyro=gyro_l_point;turn_vl=vinner_point;turn_vr=vouter_point;
			length=sizeof(gyro_l_point);
			break;
		case POINTR90:
			setangle(90);
			turn_gyro=gyro_r_point;turn_vl=vouter_point;turn_vr=vinner_point;
			length=sizeof(gyro_r_point);	
			break;
		#ifdef LOW_ENABLE
		case LT90L:
			setangle(-90);
			turn_gyro=gyro_lt90_low;turn_vl=vinner_t90_low;turn_vr=vouter_t90_low;
			length=sizeof(gyro_lt90_low);
			break;
		case RT90L:
			setangle(90);
			turn_gyro=gyro_rt90_low;turn_vl=vouter_t90_low;turn_vr=vinner_t90_low;
			length=sizeof(gyro_rt90_low);	
			break;
		case LV90L: 
			setangle(-90);
			turn_gyro=gyro_lv90_low;turn_vl=vinner_v90_low;turn_vr=vouter_v90_low;
			length=sizeof(gyro_lv90_low);	
			break;
		case RV90L: 
			setangle(90);
			turn_gyro=gyro_rv90_low;turn_vl=vouter_v90_low;turn_vr=vinner_v90_low;
			length=sizeof(gyro_rv90_low);	
			break;
		case LT45L: 
			setangle(-45);
			turn_gyro=gyro_lt45_low;turn_vl=vinner_t45_low;turn_vr=vouter_t45_low;
			length=sizeof(gyro_lt45_low);	
			break;
		case RT45L: 
			setangle(45);
			turn_gyro=gyro_rt45_low;turn_vl=vouter_t45_low;turn_vr=vinner_t45_low;
			length=sizeof(gyro_rt45_low);	
			break;
		case LV45L: 
			setangle(-45);
			turn_gyro=gyro_lv45_low;turn_vl=vinner_v45_low;turn_vr=vouter_v45_low;
			length=sizeof(gyro_lv45_low);	
			break;
		case RV45L: 
			setangle(45);
			turn_gyro=gyro_rv45_low;turn_vl=vouter_v45_low;turn_vr=vinner_v45_low;
			length=sizeof(gyro_rv45_low);	
			break;
		case LT135L: 
			setangle(-135);
			turn_gyro=gyro_lt135_low;turn_vl=vinner_t135_low;turn_vr=vouter_t135_low;
			length=sizeof(gyro_lt135_low);	
			break;
		case RT135L: 
			setangle(135);
			turn_gyro=gyro_rt135_low;turn_vl=vouter_t135_low;turn_vr=vinner_t135_low;
			length=sizeof(gyro_rt135_low);	
			break;
		case LV135L: 
			setangle(-135);
			turn_gyro=gyro_lv135_low;turn_vl=vinner_v135_low;turn_vr=vouter_v135_low;
			length=sizeof(gyro_lv135_low);	
			break;
		case RV135L: 
			setangle(135);
			turn_gyro=gyro_rv135_low;turn_vl=vouter_v135_low;turn_vr=vinner_v135_low;
			length=sizeof(gyro_rv135_low);	
			break;
		case L180L: 
			setangle(-180);
			turn_gyro=gyro_l180_low;turn_vl=vinner_180_low;turn_vr=vouter_180_low;
			length=sizeof(gyro_l180_low);	
			break;		 
		case R180L:
			setangle(180);
			turn_gyro=gyro_r180_low;turn_vl=vouter_180_low;turn_vr=vinner_180_low;
			length=sizeof(gyro_r180_low);	
			break;
		#endif
	}
	task=TURN;
	while(tick<length/2-2);
	settrack(0);
}


void taskturnaround()
{
	setangle(180);
	turn_gyro=gyro_around;
	turn_vl=vl_around;
	turn_vr=vr_around;
	eh=0;
	e=0;
	tick=0;step=0;
	task=TURNAROUND;
	while(1)
		if(step==1 && tick>10) break;//10
	settrack(0);	
}

void taskpointturnright()
{
	setangle(90);
	turn_gyro=gyro_r_point;
	turn_vl=vouter_point;
	turn_vr=vinner_point;
	eh=0;
	e=0;
	tick=0;step=0;
	task=POINTTURN90;
	while(1)
		if(step==1 && tick>10) break;
	settrack(0);	
}

void taskpointturnleft()
{
	setangle(-90);
	turn_gyro=gyro_l_point;
	turn_vl=vinner_point;
	turn_vr=vouter_point;
	eh=0;
	e=0;
	tick=0;step=0;
	task=POINTTURN90;
	while(1)
		if(step==1 && tick>10) break;
	settrack(0);	
}




//=========================================================================================
//下面是搜索没走过的格子过程中用到的4个功能函数:前进，左转，右转，回转
//每次转弯之后都会调用mazeSearch()
//=========================================================================================
void mazeSearch()				//坐标更新，调度，补全转弯后可能出现的路程
{	
	if(goaheadbugflag==1) goaheadbugflag=0;//
	eh=0;
	e=0;
	gangleh=0;
	ganglehh=0;
	peakgangle=0;
	peakgangleh=0;
	task=SMARTSTRAIGHT;
	//如果有机会执行task，一定是发生了转弯后有路程需要补全。自动根据有无墙情况选择矫正方式
	while(1)
	{
		if(track>=180)//到达逻辑节点。注意无论直走还是转弯，一格之后都应满足该条件！!!!!!!!!!
		{	
			blocknum++;//连续直线格数
			//basetrack+=180;//将基准向前“跟进”180mm。用此法保留离散采样导致可能超过180的部分.不知为何basetrack变成了负的很大的数
			settrack(0);
			if(goaheadbugflag==0) __mouseCoorUpdate();
			if(breakornot()==1){blocknum=1;break;}
		}
		if(track>90 && track<180);//直线-直线时到判断条件时必满足。直线-跳出-直线？。直线-转弯时到判断条件时必满足。转弯-转弯时可能需要补全路程。
		else
		{		  
			if(lefthaswall==1 || righthaswall==1) mazesearchhaswall();//相当于在调用mazeSearch()的时刻读一次墙，作为该格子睁眼还是闭眼的依据，可能出现问题！
			else if(lefthaswall==0 && righthaswall==0) mazesearchnowall();
		}
	}
}										 

void mazesearchhaswall()		//（用死循环）走有墙的一个格子，前半段用红外，后半段不用。若下一个格子无墙，进行纵向矫正。若放在转弯后面要加速（闭眼走试着放弃使用角度做参考）
{
	turno=0;
	if(disf<50)//明明有墙却还命令直走，则报错
	{
	 	flashwrite=0;
		setvl=0;setvr=0;
		task=NULL;
		delay_ms(300);
		sleepmode=1;
		while(1){sleepmode=1;ledoff(0);delay_ms(500);ledon(1);ledon(2);delay_ms(500);}
	}
	
	if(LastSearchAction!=Stright) settrack(track+20);	//转弯接直线 格子初始点后移20mm
	LastSearchAction=Stright;
	//taskspeedup(50);//转弯后加速
	while(track<120+8) task=SMARTSTRAIGHTFAST;			//睁眼走直线
	eh=0;e=0;
	while(track<180) task=STRAIGHTEYECLOSECOORADJ;		//闭眼走直线，若遇到有墙-无墙则进行纵向矫正
}

void mazesearchnowall()			//（用死循环）走无墙的一个格子，末段利用柱子校正姿态，若柱子之后仍无墙（排骨情况）则进行纵向矫正。若放在转弯后面要加速
{
	turno=0;
	if(disf<50)//明明有墙却还命令直走，则报错
	{
	 	flashwrite=0;
		setvl=0;setvr=0;
		task=NULL;
		delay_ms(300);
		sleepmode=1;
		while(1){sleepmode=1;ledoff(0);delay_ms(500);ledon(3);ledon(4);delay_ms(500);}
	}
	if(LastSearchAction!=Stright) settrack(track+20);
	LastSearchAction=1;
	//taskslowdown(50);//转弯后加速

	while(track<120+8) task=GOSTRAIGHT;

	dislpeak=200;
	disrpeak=200;
	lpeakfindenable=0;
	rpeakfindenable=0;
	leftpeaktrack=0;
	rightpeaktrack=0;
	tick=0;
	task=STRAIGHTPOLE;
	while(track<180);//利用柱子校正姿态，若柱子之后无墙，则进行纵向矫正
}

void before90turn(u8 Direction)				//减速，利用前方传感器调整姿态，判断转弯开始点，获取矫正距离
{
// 	int disltmp,disrtmp;								
// 	taskslowdown()				//需要能够修正纵向坐标！！！！！
// 	if(speed>speed_turn+10)taskslowdown(50);			//若直线高速搜索首次切换到转弯，则这段距离只能用于减速不能矫正(事实上直线搜索之后角度误差也比较小无需矫正)。
// 	else						//若处于连续转弯期间，则用这段距离来矫正姿态。
// 	{
		e=0;eh=0;
		task=BEFORE90TURN;		//根据前方是否有墙判断矫正方式，两种应当可以随意切换，因为前方墙在远距离时容易误判。
		while(1)
		{
// 			if(track>=(44-turno)) {turno=0;break;}		//出弯到下一次入弯之间的直线距离
			if(LastSearchAction==Stright)					//直线接转弯 多补全20-12mm
			{
				if(Direction==TurnLeft)						//左转前补全6mm
				{
					if(track>=20+20-12+4)
					{
						turno=0; break;
					}
				}
				else
				{
					if(track>=20+20-12)						//右转
					{
						turno=0; break;
					}
				}
			}
			else if(LastSearchAction==TurnLeft)
			{
				if(Direction==TurnLeft)						//左转前补全6mm
				{
					if(track>=20-8)
					{
						turno=0; break;
					}
				}
				else
				{
					if(track>=20-3)						//右转
					{
						turno=0; break;
					}
				}
			}
			else if(LastSearchAction==TurnRight)
			{
				if(Direction==TurnLeft)					//左转前补全6mm
				{
					if(track>=20-3+2)
					{
						turno=0; break;
					}
				}
				else
				{
					if(track>=20-3-2)						//右转
					{
						turno=0; break;
					}
				}
			}
		}
// 	}
}										 

u16 disbf180;
void before180turn()			//减速刹车，调整纵向距离，利用前方和左右方传感器调整水平位置到中间，角度正对墙面。
{
	settrack(0);
	task=SMARTSTRAIGHT;
	while(track<20);				//一开始前方墙面容易误判，先走一段再判断
	if(lefthaswall==1) afterturn_flag=1;
	else if(righthaswall==1) afterturn_flag=2;
		else afterturn_flag=0;
	while(track<40);

	if(forwardhaswall==0)			//根据该点探测的墙信息选择接下来的动作:刹车或用前墙定位
	{
		if(LastSearchAction==Stright) taskgostraight(70);	//之前是100,走到track=60，不是再走60
		else taskgostraight(50);	//之前是100，走到track=40，不是再走60
		disbf180=absolutetrack;
		decdistance=40; taskstop(); decdistance=40;
		disbf180=absolutetrack-disbf180+6;				//出弯到下一次入弯之间的直线距离
	}
	else if(forwardhaswall==1)
	{					   
		tick=0;
		turnaround_tick=0;
		task=BEFORE180TURN;
	 	while(tick<50);
		disbf180=60-5;
	}

	settrack(0);
	LastSearchAction=Stright;
}										 
						 

void after180turn()				//加速启动
{
//	if(((GmcMouse.cX==GucXGoal0)||(GmcMouse.cX==GucXGoal1))&&((GmcMouse.cY==GucYGoal0)||(GmcMouse.cY==GucYGoal0)))
	if( (lefthaswall==1 && abs(disl-dis2wall)<9) || (righthaswall==1 && abs(disr-dis2wall)<9) || afterturn_flag==0 )//误差在正负10mm以内就不用矫正,2015年改成8。
	{
		taskacc();			 
		taskgostraight(disbf180);
	}
	else if((GmcMouse.cX==GoalX)&&(GmcMouse.cY==GoalY))
		{
			if((GmcMouse.cX+GmcMouse.cY+GucMouseDir)%2==0)
			{
				taskturn(POINTR90);
				tick=0;
				turnaround_tick=0;
				task=KEEPWALLDISTANCE;
				while(tick<50);
				//taskturn(POINTL90);
				taskpointturnleft();
				taskacc();			 
				taskgostraight(disbf180);
			}
			else 
			{
				taskturn(POINTL90);
				tick=0;
				turnaround_tick=0;
				task=KEEPWALLDISTANCE;
				while(tick<50);
				//taskturn(POINTR90);
				taskpointturnright();
				taskacc();			 
				taskgostraight(disbf180);
			}
		}
	else if(afterturn_flag==2)
		{
			taskturn(POINTL90);
			tick=0;
			turnaround_tick=0;
			task=KEEPWALLDISTANCE;
			while(tick<50);
			//taskturn(POINTR90);
			taskpointturnright();
			taskacc();			 
			taskgostraight(disbf180);
		}
		else if(afterturn_flag==1)
			{
				taskturn(POINTR90);
				tick=0;
				turnaround_tick=0;
				task=KEEPWALLDISTANCE;
				while(tick<50);
				//taskturn(POINTL90);
				taskpointturnleft();
				taskacc();			 
				taskgostraight(disbf180);
			}
			else//两边无墙
			{
				taskacc();			 
				taskgostraight(disbf180);	
			}
	afterturn_flag=0;
}									 

void mouseTurnright()
{	 
	goaheadbugflag=0;
	before90turn(TurnRight);
	LastSearchAction=TurnRight;
	if(lefthaswall==1)
	{
		turnrighto=dis2wall-((disl+dislh+dislhh)/3);
		turno=(disr+disrh+disrhh)/3-dis2wall;
	}
	else {turnrighto=0;turno=0;}
	if(disr<50)//明明有墙却还命令转弯，则报错
	{
		flashwrite=0;
	 	setvl=0;setvr=0;
		task=NULL;
		delay_ms(300);
		sleepmode=1;
		while(1){sleepmode=1;ledoff(0);delay_ms(500);ledon(7);ledon(8);delay_ms(500);}
	}
	taskturn(RT90SEARCH);
	task=SMARTSTRAIGHT;
	GucMouseDir=(GucMouseDir + 1) % 4; 
	settrack(180-turnrighto);//转弯之后进mazeSearch(),需要立即进入判断，满足的条件是track>=180，在此人为制造该条件。
	//若右转之前车偏左，则o<0，因需要在mazeSearch()中多走完差的距离再进入判断，因此将track设置为小于180，即basetrack前移一点
}

void mouseTurnleft()
{	 
	goaheadbugflag=0;
	before90turn(TurnLeft);
	LastSearchAction=TurnLeft;
	if(righthaswall==1)
	{
		turnlefto=(disr+disrh+disrhh)/3-dis2wall;
		turno=(disr+disrh+disrhh)/3-dis2wall;
	}
	else {turnlefto=0;turno=0;}
	if(disl<50)//明明有墙却还命令转弯，则报错
	{
	 	flashwrite=0;
		setvl=0;setvr=0;
		task=NULL;
		delay_ms(300);
		sleepmode=1;
		while(1){sleepmode=1;ledoff(0);delay_ms(500);ledon(5);ledon(6);delay_ms(500);}
	}		   	
	taskturn(LT90SEARCH);
	task=SMARTSTRAIGHT;
	GucMouseDir=(GucMouseDir + 3) % 4;
	settrack(180+turnlefto);
}

void mouseTurnback()
{				
	goaheadbugflag=0;
	before180turn();
	LastSearchAction=Stright;
	taskturnaround();
	if(block_write_flag==1)
	{
		SaveBlockData();//SaveSearch_Stack();
		block_write_flag=0;
	}
	after180turn();
	GucMouseDir = (GucMouseDir + 2) % 4;
	__mouseCoorUpdate();
	settrack(0);
}

void specialmouseTurnback()
{				
	goaheadbugflag=0;
	before180turn();
	taskturnaround();
	GucMouseDir = (GucMouseDir + 2) % 4;
	settrack(0);
}


void mouseGoahead(char cNBlock)	//更高速地走直线，利用已知的有无墙情况(初始化时处理一下)，直接按照距离划分控制方式，而非按照格子。如：前360mm用左侧矫正，后180mm用右侧矫正。类似的命令方式。另外要加上转弯后加速。
{	   
	u8 n=0;			 
	goaheadbugflag=1;
	eh=0;
	e=0;
	gangleh=0;
	ganglehh=0;
	peakgangle=0;
	peakgangleh=0;
	task=SMARTSTRAIGHT;
	while(1)
	{
		if(track>=180)//到达逻辑节点。注意无论直走还是转弯，一格之后都应满足该条件！!!!!!!!!!之后将track-180
		{	
			blocknum++;//连续直线格数
			settrack(0);
			__mouseCoorUpdate();
			n++;
			if(n==cNBlock)
			{
				blocknum=1;
				break;
			}
		}
		if(track>90&&track<180);//直线-直线时到判断条件时必满足。直线-跳出-直线？。直线-转弯时到判断条件时必满足。转弯-转弯时可能需要补全路程。
		else
		{	  
			if(lefthaswall==1 || righthaswall==1) mazesearchhaswall();	//相当于在调用mazeSearch()的时刻读一次墙，作为该格子睁眼还是闭眼的依据，可能出现问题！
			else if(lefthaswall==0 && righthaswall==0) mazesearchnowall();
		}
	}
}


//=========================================================================================
//下面是冲刺相关的函数
//=========================================================================================
void spurt(u8 mode)
{
	if(mode==LOW)
	{
		SPURT90IR_kp1=0.25;
		SPURT90IR_kp2=0.15;
		SPURT90IR_kd=0;
		SPURT90GYRO_kp=0.3;
		SPURT90GYRO_kd=0;
		STRAIGHT45_kp=0.07;
		STRAIGHT45_kd=0.03;
		turn_kp=8;
		turn_kd=5;
	}
	else if(mode==MEDIUM)
	{
		SPURT90IR_kp1=0.25;
		SPURT90IR_kp2=0.15;
		SPURT90IR_kd=0;
		SPURT90GYRO_kp=0.3;
		SPURT90GYRO_kd=0;
		STRAIGHT45_kp=0.1;
		STRAIGHT45_kd=0.1;
		turn_kp=8;
		turn_kd=5;
	}
	else if(mode==HIGH)
	{	
		SPURT90IR_kp1=0.3;
		SPURT90IR_kp2=0.15;
		SPURT90IR_kd=0;
		SPURT90GYRO_kp=0.3;
		SPURT90GYRO_kd=0;
		STRAIGHT45_kp=0.1;
		STRAIGHT45_kd=0.1;
		turn_kp=10;
		turn_kd=7;
	}
	
	actiongenerate(mode);
	action(mode);
}

void spurt_90(u8 mode)
{   
	//irswitch = 0;
	SPURT90IR_kp1=0.1;//high
	SPURT90IR_kp2=0.18;
	SPURT90IR_kd=0.10;
	SPURT90GYRO_kp=0.25;
	SPURT90GYRO_kd=0.08;
	turn_kp=8;
	turn_kd=5;
	speed_turn=70;
	speed_fastss=70;
	
	actiongenerate_90(mode);
	action_90(mode);
}

int L45TopSpeed=160,L45BottomSpeed=100;

void taskstraight45(u16 dis)
{
	settrack(0);
	eh=0;
	e=0;
	gangleh=0;
	ganglehh=0;
	peakgangle=0;
	peakgangleh=0;
	ganglet=0;
	task=STRAIGHT45;
	while(track<dis)
	{
		if(speedmode==LOW)
		{
				if(dis > 180)
				{
					if(track < 90)
						speed_fastss=(L45TopSpeed-L45BottomSpeed)*track/90+L45BottomSpeed;
					else if(track < dis-90)
						speed_fastss=L45TopSpeed;
					else if(track < dis)
						speed_fastss=(L45TopSpeed-L45BottomSpeed)*(dis-track)/90+L45BottomSpeed;
				}
				else speed_fastss=L45BottomSpeed;
		}
	}
}

int ObjectGoTo_TopSpeed=70,ObjectGoTo_BottomSpeed=70;
int LTopSpeed=200,LBottomSpeed=100;
int L90TopSpeed=70,L90BottomSpeed=70;
int BackTopSpeed=200,BackBottomSpeed=70;
int TopSpeed,BottomSpeed;
float SpurtAccRatio45=0.6,SpurtDecRatio45=0.5;
float SpurtAccRatio90=0.8,SpurtDecRatio90=0.5;
float SpurtAccRatio,SpurtDecRatio;
int InitialSpeed=0;

void taskstraight90(u16 dis)
{
	turno=0;
	eh=0;
	e=0;
	settrack(0);
	InitialSpeed=speed;
//----------------------------------------------------------------------------------------------
	while(track<dis)
	{
		if(InitialSpeed < 50)									//起步
		{
			SPURT90IR_kp1=0.31;
			SPURT90IR_kp2=0.21;
			SPURT90IR_kd=0.1;
			SPURT90GYRO_kp=0.28;
			SPURT90GYRO_kd=0.10;
			if(GoOrBackFlag==1)								//返回起步
			{
				TopSpeed=BackTopSpeed;
				BottomSpeed=BackBottomSpeed;
				SpurtAccRatio=SpurtAccRatio90;
				SpurtDecRatio=SpurtDecRatio90;
			}
			else
			{
				if(speedmode==LOW_90)						//直线起步
				{
					TopSpeed=L90TopSpeed;
					BottomSpeed=L90BottomSpeed;
					SpurtAccRatio=SpurtAccRatio90;
					SpurtDecRatio=SpurtDecRatio90;
				}

				if(speedmode==LOW)							//斜线起步
				{
					TopSpeed=LTopSpeed;
					BottomSpeed=LBottomSpeed;
					SpurtAccRatio=SpurtAccRatio45;
					SpurtDecRatio=SpurtDecRatio45;
				}
			}
			if(track < BottomSpeed/(SpurtAccRatio+0.2))
				speed_ss=(SpurtAccRatio+0.2)*track;
			else if(track < (dis-(BottomSpeed/(SpurtAccRatio+0.2)))*(SpurtDecRatio/(SpurtAccRatio+SpurtDecRatio))+(BottomSpeed/(SpurtAccRatio+0.2)))
				speed_ss=SpurtAccRatio*(track-(BottomSpeed/(SpurtAccRatio+0.2)))+BottomSpeed;
			else
				speed_ss=SpurtDecRatio*(dis-track)+BottomSpeed;
			if(speed_ss < 10)
				speed_ss=10;
			if(speed_ss > TopSpeed)
				speed_ss=TopSpeed;
		}
		else
		{
			if(ObjectGoTo_Flag==1)							//搜索返回指定坐标
			{
				SPURT90IR_kp1=0.5;
				SPURT90IR_kp2=0.35;
				SPURT90IR_kd=2;
				SPURT90GYRO_kp=0.4;
				SPURT90GYRO_kd=0.4;
				if(dis > 180)
				{
					if(track < 100)
						speed_ss=(ObjectGoTo_TopSpeed-ObjectGoTo_BottomSpeed)*track/100+ObjectGoTo_BottomSpeed;
					else if(track > dis-80 && track < dis)
						speed_ss=(ObjectGoTo_TopSpeed-ObjectGoTo_BottomSpeed)*(dis-track)/80+ObjectGoTo_BottomSpeed;
				}
				else speed_ss=ObjectGoTo_BottomSpeed;	
			}			
			else
			{
				if(GoOrBackFlag==1)							//返回
				{
					SPURT90IR_kp1=0.5;
					SPURT90IR_kp2=0.35;
					SPURT90IR_kd=1;
					SPURT90GYRO_kp=0.25;
					SPURT90GYRO_kd=0.08;
					TopSpeed=BackTopSpeed;
					BottomSpeed=BackBottomSpeed;
					SpurtAccRatio=SpurtAccRatio90;
					SpurtDecRatio=SpurtDecRatio90;
				}
				else
				{
					if(speedmode==LOW_90)					//直线冲刺
					{
						SPURT90IR_kp1=0.4;
						SPURT90IR_kp2=0.3;
						SPURT90IR_kd=0.3;
						SPURT90GYRO_kp=0.25;
						SPURT90GYRO_kd=0.08;
						TopSpeed=L90TopSpeed;
						BottomSpeed=L90BottomSpeed;
						SpurtAccRatio=SpurtAccRatio90;
						SpurtDecRatio=SpurtDecRatio90;
					}

					if(speedmode==LOW)						//斜线冲刺
					{
						SPURT90IR_kp1=0.4;
						SPURT90IR_kp2=0.3;
						SPURT90IR_kd=0.3;
						SPURT90GYRO_kp=0.4;
						SPURT90GYRO_kd=0.4;
						TopSpeed=LTopSpeed;
						BottomSpeed=LBottomSpeed;
						SpurtAccRatio=SpurtAccRatio45;
						SpurtDecRatio=SpurtDecRatio45;
					}
				}
				if(track < dis*(SpurtDecRatio/(SpurtAccRatio+SpurtDecRatio)))
					speed_ss=SpurtAccRatio*track+BottomSpeed;
				else
					speed_ss=SpurtDecRatio*(dis-track)+BottomSpeed;
				if(speed_ss > TopSpeed)
					speed_ss=TopSpeed;
			}
		}
		if(track%180>20 && track%180<100) task=SPURT90BLIND;		//闭眼走
		else
		{
			if(lefthaswall==1 || righthaswall==1) task=SPURT90IR;	//睁眼走
			else task=SPURT90BLIND;									//闭眼走
		}
		if(disf<20) isemergency=1;
	}
}

//先尝试不进行水平误差修正版本
void beforemouseturn(u8 pattern)
{
	int beforeturntrack;
	e=0;eh=0;
	switch(pattern)
	{
		//low speed
		case LV45L:	beforeturntrack=3; speed_fastss=100;	goto BFLV;
		case LV90L:	beforeturntrack=7; speed_fastss=100;	goto BFLV;
		case LV135L:beforeturntrack=9; speed_fastss=100;	goto BFLV;
		case RV45L:	beforeturntrack=3; speed_fastss=100;	goto BFRV;
		case RV90L:	beforeturntrack=7; speed_fastss=100;	goto BFRV;
		case RV135L:beforeturntrack=9; speed_fastss=100;	goto BFRV;
		
		case LT45L:	beforeturntrack=0; speed_ss=100;
					sidewall_threshold=110;					goto BFL;
		case LT90L:	beforeturntrack=10;speed_ss=70;		goto BFL;
		case LT135L:beforeturntrack=14;speed_ss=100;		goto BFL;
		case L180L:	beforeturntrack=0; speed_ss=100;		goto BFL;
		
		case RT45L:	beforeturntrack=0; speed_ss=100;
					sidewall_threshold=110;					goto BFR;
		case RT90L:	beforeturntrack=10;speed_ss=70;		goto BFR;
		case RT135L:beforeturntrack=14;speed_ss=100;		goto BFR;
		case R180L:	beforeturntrack=0; speed_ss=100;		goto BFR;

		//medium speed
		case LV45M:beforeturntrack=7;	goto BFLV;
		case LV90M:beforeturntrack=7;	goto BFLV;
		case LV135M:beforeturntrack=7;	goto BFLV;
		case RV45M:beforeturntrack=7;	goto BFRV;
		case RV90M:beforeturntrack=7;	goto BFRV;
		case RV135M:beforeturntrack=7;	goto BFRV;
		
		case LT45M:beforeturntrack=0;	goto BFL;
		case LT90M:beforeturntrack=23;	goto BFL;
		case LT135M:beforeturntrack=23;	goto BFL;
		case L180M:beforeturntrack=0;	goto BFL;
		
		case RT45M:beforeturntrack=0;	goto BFR;
		case RT90M:beforeturntrack=23;	goto BFR;
		case RT135M:beforeturntrack=23;	goto BFR;
		case R180M:beforeturntrack=0;	goto BFR;

		//HIGH SPEED		
		case LV45H:beforeturntrack=0;	goto BFLV;
		case LV90H:beforeturntrack=0;	goto BFLV;
		case LV135H:beforeturntrack=0;	goto BFLV;
		case RV45H:beforeturntrack=0;	goto BFRV;
		case RV90H:beforeturntrack=0;	goto BFRV;
		case RV135H:beforeturntrack=0;	goto BFRV;
		
		case LT45H:beforeturntrack=0;	goto BFL;
		case LT90H:beforeturntrack=0;	goto BFL;
		case LT135H:beforeturntrack=0;	goto BFL;
		case L180H:beforeturntrack=0;	goto BFL;
		
		case RT45H:beforeturntrack=0;	goto BFR;
		case RT90H:beforeturntrack=0;	goto BFR;
		case RT135H:beforeturntrack=0;	goto BFR;
		case R180H:beforeturntrack=0;	goto BFR;	
				
BFLV:
		while(1)
		{
			task=STRAIGHT45;
			if(leftwallcriticalhhh==1 && leftwallcriticalhh==1 && leftwallcriticalh==1 && leftwallcritical==0) break;
		}
		settrack(0);
		while(track<beforeturntrack)task=STRAIGHT45;
		break;
BFRV:
		while(1)
		{
			task=STRAIGHT45;
			if(rightwallcriticalhhh==1 && rightwallcriticalhh==1 && rightwallcriticalh==0 && rightwallcritical==0) break;
		}
		settrack(0);
		while(track<beforeturntrack) task=STRAIGHT45;
		break;				
BFL:
		while(1)
		{
			task=SMARTSTRAIGHTSPURTL;
			if(lefthaswallh==1 && lefthaswall==0) break;
		}
		sidewall_threshold=160;
		settrack(0);
		while(track<beforeturntrack) task=SMARTSTRAIGHTSPURTL;
		break;
BFR:
		while(1)
		{
			task=SMARTSTRAIGHTSPURTL;
			if(righthaswallh==1 && righthaswall==0) break;
		}
		sidewall_threshold=160;
		settrack(0);
		while(track<beforeturntrack) task=SMARTSTRAIGHTSPURTL;
		break;
	}
}

void mouseturn(u8 pattern)		//先尝试不用已知墙信息来矫正，看看效果。这样的话也就无需更新坐标了。
{
	beforemouseturn(pattern);
	taskturn(pattern);
	ledoff(0);
	speed_ss=70; speed_fastss=100;
}


u16 i=0;
//FastwayAction是转弯序列：0代表直走，1右转45度，2右转90度，7左转45度，6左转90度
//	int FastwayAction[]={1,0,0,2,0,6,7,0,1,1,1,0,0,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1,0};
//	int FastwayAction[]={1,2,0,7,7,6,0,0,7,1,2,1,0,7,7,7,7,7,0,2,1,1,0,0,2,0,6,7};
//	int FastwayAction[]={0,1,0,0,0,7,1,1,7,0,0,7,1,1};
//	int FastwayAction[]={0,0,0,0,0,0,0,0,0,0,0,1,1,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1,1};


int getsum(int num)
{
	int ret=0,i=0;
	for(i=0;i<=num;i++) ret+=FastwayAction[i].action;
	return ret;
}

int getfinaldir()
{
	int ret=0,i=0;
	for(i=0;i<FastwayCount;i++)
	{
		if(FastwayAction[i].action==7) ret+=-1;
		else if(FastwayAction[i].action==6) ret+=-2;
		else ret+=FastwayAction[i].action;
	}
	return ret%8;
}

void actiongenerate(u8 mode)	//由一串左转右转命令转化为动作序列
{
	//int sum=0;
	int current=0;
	u16 i=0,j=0;
//============================直线校正参数设定================================	2015年新增
	uchar k=0,dirtemp=0,leftdir=0,rightdir=0;
	for(i=0;i<200;i++)
	{
		actionsequence[i]=0;
		action_correct_sequence[i]=0;
	}
//=============================================================================

	if(mode==LOW)
	{  	
		for(i=0;i<FastwayCount-1;i++)//
		{	
			if(i<current)continue;
	
			if(FastwayAction[i+1].action==1  && FastwayAction[i+2].action==2 && FastwayAction[i+3].action==1 && getsum(i)%2==0){actionsequence[j++]=R180L;current+=3;}
			else if(FastwayAction[i+1].action==7 && FastwayAction[i+2].action==6 && FastwayAction[i+3].action==7 && getsum(i)%2==0){actionsequence[j++]=L180L;current+=3;}
			else if(FastwayAction[i+1].action==2 && FastwayAction[i+2].action==1 && getsum(i)%2==1){actionsequence[j++]=RV135L;current+=2;}//////
			else if(FastwayAction[i+1].action==6 && FastwayAction[i+2].action==7 && getsum(i)%2==1){actionsequence[j++]=LV135L;current+=2;}
			else if(FastwayAction[i+1].action==1 && FastwayAction[i+2].action==2 && getsum(i)%2==0){actionsequence[j++]=RT135L;current+=3;}//////
			else if(FastwayAction[i+1].action==7 && FastwayAction[i+2].action==6 && getsum(i)%2==0){actionsequence[j++]=LT135L;current+=3;}
			else if(FastwayAction[i+1].action==7 && FastwayAction[i+2].action==7 && getsum(i)%2==0){actionsequence[j++]=LT90L;current+=2;}
			else if(FastwayAction[i+1].action==1 && FastwayAction[i+2].action==1 && getsum(i)%2==0){actionsequence[j++]=RT90L;current+=2;}
			else if(FastwayAction[i+1].action==2 && getsum(i)%2==1){actionsequence[j++]=RV90L;current+=2;}
			else if(FastwayAction[i+1].action==6 && getsum(i)%2==1){actionsequence[j++]=LV90L;current+=2;}
			else if(FastwayAction[i+1].action==1 && getsum(i)%2==0){actionsequence[j++]=RT45L;current+=2;}
			else if(FastwayAction[i+1].action==7 && getsum(i)%2==0){actionsequence[j++]=LT45L;current+=2;}
			else if(FastwayAction[i+1].action==1 && getsum(i)%2==1){actionsequence[j++]=RV45L;current+=1;}
			else if(FastwayAction[i+1].action==7 && getsum(i)%2==1){actionsequence[j++]=LV45L;current+=1;}
			else if(FastwayAction[i+1].action==0 && getsum(i)%2==0)
			{
				actionsequence[j]=STRAIGHT90L;
//======================================直线校正参数设定===============================================		2015年新增
				if(spurtTestFlag==0)						
				{
					dirtemp=(Mapfastway[FastwayAction[i+1].cx][FastwayAction[i+1].cy])/2;
					leftdir=(dirtemp+3)%4;rightdir=(dirtemp+1)%4;
						
					if( (GucMapBlock[FastwayAction[i+1].cx][FastwayAction[i+1].cy] & (1<<leftdir))
							  && (GucMapBlock[FastwayAction[i+1].cx][FastwayAction[i+1].cy] & (1<<rightdir)))
					{
						action_correct_sequence[j++]=BOTHSIDE;
						if( action_correct_sequence[j-2]==LEFTSIDE||action_correct_sequence[j-1]==RIGHTSIDE )
							action_correct_sequence[j-1]=action_correct_sequence[j-2];
					}
						else if( GucMapBlock[FastwayAction[i+1].cx][FastwayAction[i+1].cy] & (1<<leftdir) )
							{
								action_correct_sequence[j++]=LEFTSIDE;
								for(k=j-2;action_correct_sequence[k]==BOTHSIDE;k--) 
									action_correct_sequence[k]=LEFTSIDE;
							}
						else if( GucMapBlock[FastwayAction[i+1].cx][FastwayAction[i+1].cy] & (1<<rightdir) )
							{
								action_correct_sequence[j++]=RIGHTSIDE;
								for(k=j-2;action_correct_sequence[k]==BOTHSIDE;k--) 
									action_correct_sequence[k]=RIGHTSIDE;
							}
						else action_correct_sequence[j++]=NOSIDE;
				}				
//============================================================================================						
				current+=1;
			}
			else if(FastwayAction[i+1].action==0 && getsum(i)%2==1)
				{
					actionsequence[j++]=STRAIGHT45L;current+=1;
				}
		}
	}
	else if(mode==MEDIUM)
	{	 
		for(i=0;i<FastwayCount-1;i++)//
		{	
			if(i<current)continue;
	
			if(FastwayAction[i+1].action==1  && FastwayAction[i+2].action==2 && FastwayAction[i+3].action==1 && getsum(i)%2==0){actionsequence[j++]=R180M;current+=3;}
			else if(FastwayAction[i+1].action==7 && FastwayAction[i+2].action==6 && FastwayAction[i+3].action==7 && getsum(i)%2==0){actionsequence[j++]=L180M;current+=3;}
			else if(FastwayAction[i+1].action==2 && FastwayAction[i+2].action==1 && getsum(i)%2==1){actionsequence[j++]=RV135M;current+=2;}//////
			else if(FastwayAction[i+1].action==6 && FastwayAction[i+2].action==7 && getsum(i)%2==1){actionsequence[j++]=LV135M;current+=2;}
			else if(FastwayAction[i+1].action==1 && FastwayAction[i+2].action==2 && getsum(i)%2==0){actionsequence[j++]=RT135M;current+=3;}//////
			else if(FastwayAction[i+1].action==7 && FastwayAction[i+2].action==6 && getsum(i)%2==0){actionsequence[j++]=LT135M;current+=3;}
			else if(FastwayAction[i+1].action==7 && FastwayAction[i+2].action==7 && getsum(i)%2==0){actionsequence[j++]=LT90M;current+=2;}
			else if(FastwayAction[i+1].action==1 && FastwayAction[i+2].action==1 && getsum(i)%2==0){actionsequence[j++]=RT90M;current+=2;}
			else if(FastwayAction[i+1].action==2 && getsum(i)%2==1){actionsequence[j++]=RV90M;current+=2;}
			else if(FastwayAction[i+1].action==6 && getsum(i)%2==1){actionsequence[j++]=LV90M;current+=2;}
			else if(FastwayAction[i+1].action==1 && getsum(i)%2==0){actionsequence[j++]=RT45M;current+=2;}
			else if(FastwayAction[i+1].action==7 && getsum(i)%2==0){actionsequence[j++]=LT45M;current+=2;}
			else if(FastwayAction[i+1].action==1 && getsum(i)%2==1){actionsequence[j++]=RV45M;current+=1;}
			else if(FastwayAction[i+1].action==7 && getsum(i)%2==1){actionsequence[j++]=LV45M;current+=1;}
			else if(FastwayAction[i+1].action==0 && getsum(i)%2==0){actionsequence[j++]=STRAIGHT90M;current+=1;}
			else if(FastwayAction[i+1].action==0 && getsum(i)%2==1){actionsequence[j++]=STRAIGHT45M;current+=1;}
		}
	}
	else if(mode==HIGH)
	{
		for(i=0;i<FastwayCount-1;i++)
		{	
			if(i<current)continue;
	
			if(FastwayAction[i+1].action==1  && FastwayAction[i+2].action==2 && FastwayAction[i+3].action==1 && getsum(i)%2==0){actionsequence[j++]=R180H;current+=3;}
			else if(FastwayAction[i+1].action==7 && FastwayAction[i+2].action==6 && FastwayAction[i+3].action==7 && getsum(i)%2==0){actionsequence[j++]=L180H;current+=3;}
			else if(FastwayAction[i+1].action==2 && FastwayAction[i+2].action==1 && getsum(i)%2==1){actionsequence[j++]=RV135H;current+=2;}//////
			else if(FastwayAction[i+1].action==6 && FastwayAction[i+2].action==7 && getsum(i)%2==1){actionsequence[j++]=LV135H;current+=2;}
			else if(FastwayAction[i+1].action==1 && FastwayAction[i+2].action==2 && getsum(i)%2==0){actionsequence[j++]=RT135H;current+=3;}//////
			else if(FastwayAction[i+1].action==7 && FastwayAction[i+2].action==6 && getsum(i)%2==0){actionsequence[j++]=LT135H;current+=3;}
			else if(FastwayAction[i+1].action==7 && FastwayAction[i+2].action==7 && getsum(i)%2==0){actionsequence[j++]=LT90H;current+=2;}
			else if(FastwayAction[i+1].action==1 && FastwayAction[i+2].action==1 && getsum(i)%2==0){actionsequence[j++]=RT90H;current+=2;}
			else if(FastwayAction[i+1].action==2 && getsum(i)%2==1){actionsequence[j++]=RV90H;current+=2;}
			else if(FastwayAction[i+1].action==6 && getsum(i)%2==1){actionsequence[j++]=LV90H;current+=2;}
			else if(FastwayAction[i+1].action==1 && getsum(i)%2==0){actionsequence[j++]=RT45H;current+=2;}
			else if(FastwayAction[i+1].action==7 && getsum(i)%2==0){actionsequence[j++]=LT45H;current+=2;}
			else if(FastwayAction[i+1].action==1 && getsum(i)%2==1){actionsequence[j++]=RV45H;current+=1;}
			else if(FastwayAction[i+1].action==7 && getsum(i)%2==1){actionsequence[j++]=LV45H;current+=1;}
			else if(FastwayAction[i+1].action==0 && getsum(i)%2==0){actionsequence[j++]=STRAIGHT90H;current+=1;}
			else if(FastwayAction[i+1].action==0 && getsum(i)%2==1){actionsequence[j++]=STRAIGHT45H;current+=1;}
		}
	}
}


void action (u8 mode)
{
 u16 i=0,num=0;

	speedmode=mode;

	if(mode==LOW)
	{	
		#ifndef LOW_ENABLE
		while(1)
		{
			ledoff(0);ledon(1);ledon(8);delay_ms(500);ledoff(0);ledon(3);ledon(6);delay_ms(500);
		}
		#endif
// 		taskacc();
		while(actionsequence[i]!=0)
		{
			if(actionsequence[i]==STRAIGHT45L)
			{	
				num=0;
				while(actionsequence[i]==STRAIGHT45L)
				{
				 	num++;
					i++;
					spurt_action_num++;
				}
				taskstraight45(127*num);
			}
			else if(actionsequence[i]==STRAIGHT90L)
			{
// 				else GoOrBackFlag=1;			
				num=0;
				while(actionsequence[i]==STRAIGHT90L)
				{
				 	num++;
					i++;
					spurt_action_num++;
				}
				taskstraight90(180*num);
			}
			else
			{
				spurt_45_end_flag=0; 			
				mouseturn(actionsequence[i]);
		 		i++;
				spurt_action_num++;
			}
		}
		ledoff(0);ledon(1);ledon(2);ledon(3);ledon(4);
			if(BackSearchFlag==0)
				decdistance=40;
			else if(BackSearchFlag==1)
				decdistance=120+150;//2014新增，冲刺到终点后刹车距离长一点！！！！！！！！！！！！！！！！
			else decdistance=120;
			if(spurtTestFlag==1) decdistance=20;//对应冲刺调试模式中，返回起点最后的减速距离。
		taskstop();
//===========================================================================
//=======================2016年3月18日修改顶层===============================
//=======================到终点就返回起点冲刺================================
		if(BackSearchFlag==1)
		{tick=0;
			turnaround_tick=0;
			task=KEEPWALLDISTANCE;
			while(tick<50);
		}
//===========================================================================			
		ledoff(0);
	}
	if(mode==MEDIUM)
	{	 
		#ifndef MEDIUM_ENABLE
		while(1)
		{
			ledoff(0);ledon(1);ledon(8);delay_ms(500);ledoff(0);ledon(3);ledon(6);delay_ms(500);
		}
		#endif
		//taskacc();
		while(actionsequence[i]!=0)
		{
			if(actionsequence[i]==STRAIGHT45M)
			{
				num=0;
				while(actionsequence[i]==STRAIGHT45M)
				{
				 	num++;
					i++;
				}
				//if(actionsequence[i+1]==)speed_turn=;
				taskstraight45(127*num);//需要改成中速的直线
			}
			else if(actionsequence[i]==STRAIGHT90M)
			{
				num=0;
				while(actionsequence[i]==STRAIGHT90M)
				{
				 	num++;
					i++;
				}
				taskstraight90(180*num);//需要改成中速的直线
			}
			else
			{
				mouseturn(actionsequence[i]);
		 		i++;
			}
		}
		decdistance=120;
		taskstop();
	}
	if(mode==HIGH)
	{
		#ifndef HIGH_ENABLE
		while(1)
		{
			ledoff(0);ledon(1);ledon(8);delay_ms(500);ledoff(0);ledon(3);ledon(6);delay_ms(500);
		}
		#endif
		//taskacc();
		while(actionsequence[i]!=0)
		{
			if(actionsequence[i]==STRAIGHT45H)
			{
				num=0;
				while(actionsequence[i]==STRAIGHT45H)
				{
				 	num++;
					i++;
				}
				taskstraight45(127*num);//需要改成高速的直线
			}
			else if(actionsequence[i]==STRAIGHT90H)
			{
				num=0;
				while(actionsequence[i]==STRAIGHT90H)
				{
				 	num++;
					i++;
				}
				taskstraight90(180*num);//需要改成高速的直线
			}
			else
			{
				mouseturn(actionsequence[i]);
		 		i++;
			}
		}
		decdistance=120;
		taskstop();
	}
}


//---------------------------------垂直冲刺------------------------------------------



void actiongenerate_90(u8 mode)	//由一串左转右转命令转化为动作序列
{
	//int sum=0;
	int current=0;
	u16 i=0,j=0;
//============================直线校正参数设定================================	2015年新增
	uchar k=0,dirtemp=0,leftdir=0,rightdir=0;
	for(i=0;i<200;i++)
	{actionsequence[i]=0;action_correct_sequence[i]=0;}
//=============================================================================
	if(mode==LOW_90)
	{  	
		for(i=0;i<FastwayCount_90-1;i++)//
		{	
			if(i<current)continue;
			if(FastwayAction_90[i+1].action==1 ){actionsequence[j++]=RT90SEARCH;current+=1;}
			if(FastwayAction_90[i+1].action==3 ){actionsequence[j++]=LT90SEARCH;current+=1;}
			if(FastwayAction_90[i+1].action==0 )
			{
				actionsequence[j]=STRAIGHT_spurt_90;
//======================================直线校正参数设定===============================================		2015年新增				
				dirtemp=Mapfastway[FastwayAction[i+1].cx][FastwayAction[i+1].cy];
				leftdir=(dirtemp+3)%4;rightdir=(dirtemp+1)%4;
				
				if( (GucMapBlock[FastwayAction[i+1].cx][FastwayAction[i+1].cy] & (1<<leftdir))
					  && (GucMapBlock[FastwayAction[i+1].cx][FastwayAction[i+1].cy] & (1<<rightdir)))
						{action_correct_sequence[j++]=BOTHSIDE;
						if(action_correct_sequence[j-2]==LEFTSIDE||action_correct_sequence[j-1]==RIGHTSIDE)
						action_correct_sequence[j-1]=action_correct_sequence[j-2];}
				else if( GucMapBlock[FastwayAction[i+1].cx][FastwayAction[i+1].cy] & (1<<leftdir) )
						{action_correct_sequence[j++]=LEFTSIDE;
							for(k=j-2;action_correct_sequence[k]==BOTHSIDE;k--) 
							action_correct_sequence[k]=LEFTSIDE;}
				else if( GucMapBlock[FastwayAction[i+1].cx][FastwayAction[i+1].cy] & (1<<rightdir) )
						{action_correct_sequence[j++]=RIGHTSIDE;
							for(k=j-2;action_correct_sequence[k]==BOTHSIDE;k--) 
							action_correct_sequence[k]=RIGHTSIDE;}
				else action_correct_sequence[j++]=NOSIDE;					
//============================================================================================	
				current+=1;
			}
		}
	}
}


void action_90(u8 mode)
{
 	u16 i=0,num=0;

	speedmode=mode;

	if(mode==LOW_90)
	{
		#ifndef LOW_90_ENABLE
		while(1)
		{
			ledoff(0);ledon(1);ledon(8);delay_ms(500);ledoff(0);ledon(3);ledon(6);delay_ms(500);
		}
		#endif
// 		taskacc();
		if( (actionsequence[0]==RT90SEARCH) || actionsequence[0]==LT90SEARCH )
		{
//-----------------------------------------------------------------------------------------
			if(actionsequence[i]==RT90SEARCH)
			{
				task=SMARTSTRAIGHT;
				while(1)
					if(righthaswallh==1 && righthaswall==0) break;
				settrack(0);
				while(1)
					if(track>=36) break;
			}
			if(actionsequence[i]==LT90SEARCH)
			{
				task=SMARTSTRAIGHT;
				while(1)
					if(lefthaswallh==1&&lefthaswall==0) break;
				settrack(0);
				while(1)
					if(track>=36) break;
			}
//-----------------------------------------------------------------------------------------
		}
		while(actionsequence[i]!=0)
		{
			if(actionsequence[i]==STRAIGHT_spurt_90)
			{
				num=0;
				while(actionsequence[i]==STRAIGHT_spurt_90)
				{
					num++;
					i++;
				}
				if( GoOrBackFlag==1 && back90_flag==1 && actionsequence[0]==STRAIGHT_spurt_90 )
				{
					if(GucMouseTask==SPURT_45)
					{
						if(num==1)
						{
							taskstraight90(80*num+80);
							settrack(0);
						}
						else taskstraight90(180*num-100+80);
					}
					else if(GucMouseTask==SPURT_90)
						{
							if(num==1)
							{
								taskstraight90(80*num+80);
								settrack(0);
							}
							else taskstraight90(180*num-100+80);
						}
						back90_flag=0;
				}
				else if(num==1)
					{
						taskstraight90(80*num);
						settrack(0);
					}
					else taskstraight90(180*num-100);	//小于180 65=175-110
//-----------------------------------------------------------------------------------------
				if(actionsequence[i]==RT90SEARCH)
				{
					task=SMARTSTRAIGHT;
					while(1)
						if(righthaswallh==1&&righthaswall==0) break;
					settrack(0);
					while(1)
						if(track>=36) break;
				}
				if(actionsequence[i]==LT90SEARCH)
				{
					task=SMARTSTRAIGHT;
					while(1)
						if(lefthaswallh==1&&lefthaswall==0) break;
					settrack(0);
					while(1)
						if(track>=36) break;
				}
//-----------------------------------------------------------------------------------------
			}
			else
			{
// 				else GoOrBackFlag=1;		
				spurt_45_end_flag=0; 
				if(actionsequence[i]==RT90SEARCH) mouseTurnright_spurt();
				if(actionsequence[i]==LT90SEARCH) mouseTurnleft_spurt();
				i++;
			}
		}
		if(GoOrBackFlag==1) decdistance=30;
		else 			if(BackSearchFlag==0)
				decdistance=30;
			else if(BackSearchFlag==1)
				decdistance=30+150;//2014新增，冲刺到终点后刹车距离长一点！！！！！！！！！！！！！！！！
			else decdistance=30;
		taskstop();
//===========================================================================
//=======================2016年3月18日修改顶层===============================
//=======================到终点就返回起点冲刺================================
		if(BackSearchFlag==1)
		{tick=0;
		turnaround_tick=0;
		task=KEEPWALLDISTANCE;
		while(tick<50);
		}
//===========================================================================			

	}
	
}

int getfinaldir_90()
{
	int ret=0,i=0;
	for(i=0;i<FastwayCount_90;i++)
	{
		if(FastwayAction_90[i].action==3) ret+=-1;
		else ret+=FastwayAction_90[i].action;
	}
	return ret%4;
}

//---------------------------------垂直冲刺动作------------------------------------------
void mouseTurnright_spurt()
{
	goaheadbugflag=0;
	before90turn_r_spurt();
	if(lefthaswall==1)
	{
		turnrighto=dis2wall-((disl+dislh+dislhh)/3);
		turno=(disr+disrh+disrhh)/3-dis2wall;
	}
	else
	{
		turnrighto=0;
		turno=0;
	}
	taskturn(RT90SPURT);  //对应拐弯前的track也要改为10*2.
	task=SMARTSTRAIGHT;
	GucMouseDir=(GucMouseDir + 1) % 4; 
	settrack(180-turnrighto);
	task=SMARTSTRAIGHT;
	while(track<=180);
	settrack(0);
}

void mouseTurnleft_spurt()
{
	goaheadbugflag=0;
	before90turn_l_spurt();
	if(righthaswall==1)
	{
		turnlefto=(disr+disrh+disrhh)/3-dis2wall;
		turno=(disr+disrh+disrhh)/3-dis2wall;
	}
	else
	{
		turnlefto=0;
		turno=0;
	}
	taskturn(LT90SPURT);  //对应拐弯前的track也要改为10*2.
	task=SMARTSTRAIGHT;
	GucMouseDir=(GucMouseDir + 3) % 4;
	settrack(180+turnlefto);
	task=SMARTSTRAIGHT;
	while(track<=180);
	settrack(0);
}

void before90turn_l_spurt()		//减速，利用前方传感器调整姿态，判断转弯开始点，获取矫正距离
{
	//int disltmp,disrtmp;								

											//taskslowdown()需要能够修正纵向坐标！！！！！
	//if(speed>speed_turn+10)taskslowdown(50);//若直线高速搜索首次切换到转弯，则这段距离只能用于减速不能矫正(事实上直线搜索之后角度误差也比较小无需矫正)。
	//else//若处于连续转弯期间，则用这段距离来矫正姿态。
	{
		e=0;eh=0;
// 		task=SMARTSTRAIGHT;
// 		while(1)
// 		{
// 			if(lefthaswallh==1&&lefthaswall==0)break;
//     }
		settrack(0);
// 		while(1)
// 		{if(track>=30)break;}
		task=BEFORE90TURN;//根据前方是否有墙判断矫正方式，两种应当可以随意切换，因为前方墙在远距离时容易误判。
		while(1)
		{
// 			if(track>=(44-turno)) {turno=0;break;}//出弯到下一次入弯之间的直线距离
			if(track>=20) {turno=0;break;}
			//出弯到下一次入弯之间的直线距离			//出弯到下一次入弯之间的直线距离   //58-22=36   44+36=80;
		}
	}

}	
void before90turn_r_spurt()		//减速，利用前方传感器调整姿态，判断转弯开始点，获取矫正距离
{
	//int disltmp,disrtmp;								
	//taskslowdown()需要能够修正纵向坐标！！！！！
	//if(speed>speed_turn+10)taskslowdown(50);//若直线高速搜索首次切换到转弯，则这段距离只能用于减速不能矫正(事实上直线搜索之后角度误差也比较小无需矫正)。
	//else//若处于连续转弯期间，则用这段距离来矫正姿态。
	{
		e=0;eh=0;
// 		task=SMARTSTRAIGHT;
// 		while(1)
// 		{
// 			if(righthaswallh==1&&righthaswall==0)break;
//     }
		settrack(0);
// 		while(1)
// 		{if(track>=30)break;}
		task=BEFORE90TURN;//根据前方是否有墙判断矫正方式，两种应当可以随意切换，因为前方墙在远距离时容易误判。
		while(1)
		{
		if(track>=20) {turno=0;break;}//出弯到下一次入弯之间的直线距离		
			}
	}

}	


void spurt_back_mouseTurnback()
{				
	goaheadbugflag=0;
	settrack(0);
	
	task=SMARTSTRAIGHT;			   
	tick=0;
	turnaround_tick=0;
	task=BEFORE180TURN;
	while(tick<50);
	settrack(0);

	taskturnaround();
	GucMouseDir = (GucMouseDir + 2) % 4;
	settrack(0);
}






