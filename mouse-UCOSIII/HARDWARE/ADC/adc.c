#include <stm32f10x.h>
#include "sys.h"
#include "usart.h"		
#include "delay.h"	
#include "timer.h"
#include "adc.h"
#include "led.h"
#include <math.h>

//////////////////////////////////////////////////////////////////////////////////
//本文件可用资源清单
//公用函数：getdistance(int dir);
//全局变量：无
//////////////////////////////////////////////////////////////////////////////////
	   
//////////////////////////////////////////////////////////////////////////////////
//函数类型：初始化函数，只需调用一次
//函数描述：初始化ADC设置
//硬件接口：PC0~5、PB0输入
//////////////////////////////////////////////////////////////////////////////////
void  Adc_Init(void)
{    
	//先初始化IO口
	RCC->APB2ENR|=1<<2;    	//使能PORTA时钟	
	GPIOA->CRL&=0XFFFFFF00;	//PA0-0通道，PA1-1通道 Anolog输入
	
 	RCC->APB2ENR|=1<<4;    	//使能PORTC口时钟 
	GPIOC->CRL&=0XF0FF0000;	//PC0,1,2,3 Anolog输入 通道10,11,12,13；PC6推挽输出
	GPIOC->CRL|=0X03000000;	//PC6推挽输出
	
	RCC->APB2ENR|=1<<3;    	//使能PORTB口时钟 
	GPIOB->CRH&=0X000FFFFF; //清除原始设置
	GPIOB->CRH|=0X33300000;	//PB13,14,15推挽输出

	//通道10/11设置			 
	RCC->APB2ENR|=1<<9;    	//ADC1时钟使能	  
	RCC->APB2RSTR|=1<<9;   	//ADC1复位
	RCC->APB2RSTR&=~(1<<9);	//复位结束	    
	RCC->CFGR&=~(3<<14);   	//分频因子清零	
	//SYSCLK/DIV2=12M ADC时钟设置为12M,ADC最大时钟不能超过14M!
	//否则将导致ADC准确度下降! 
	RCC->CFGR|=2<<14;		//6分频

	ADC1->CR1&=0X00F0FFFF;	//工作模式清零
	ADC1->CR1|=0<<16;		//独立工作模式  
	ADC1->CR1&=~(1<<8);		//非扫描模式	  
	ADC1->CR2&=~(1<<1);		//单次转换模式 
	ADC1->CR2|=7<<17;		//软件控制转换  
	ADC1->CR2|=1<<20;		//使用用外部触发(SWSTART)!!!	必须使用一个事件来触发
	ADC1->CR2&=~(1<<11);	//右对齐	 

	ADC1->SQR1&=~(0XF<<20);	//1个转换在规则序列

	//设置采样时间
	ADC1->SMPR1&=0XFFFFF000;//通道10,11,12,13采样时间清空	  
	ADC1->SMPR2&=0XFFFFFFC0;
	ADC1->SMPR1|=7<<9;      //通道13  239.5周期,提高采样时间可以提高精确度	 
	ADC1->SMPR1|=7<<6;      //通道12  239.5周期,提高采样时间可以提高精确度	 
	ADC1->SMPR1|=7<<3;      //通道11  239.5周期,提高采样时间可以提高精确度	 
	ADC1->SMPR1|=7<<0;      //通道10  239.5周期,提高采样时间可以提高精确度	 
	ADC1->SMPR2|=7<<3;		//通道1  239.5周期,提高采样时间可以提高精确度	
	ADC1->SMPR2|=7<<0;		//通道0  239.5周期,提高采样时间可以提高精确度	

	ADC1->CR2|=1<<0;	    //开启AD转换器	 
	ADC1->CR2|=1<<3;        //使能复位校准  
	while(ADC1->CR2&1<<3);  //等待校准结束 			 
  //该位由软件设置并由硬件清除。在校准寄存器被初始化后该位将被清除。 		 
	ADC1->CR2|=1<<2;        //开启AD校准	   
	while(ADC1->CR2&1<<2);  //等待校准结束
	//该位由软件设置以开始校准，并在校准结束时由硬件清除  
}	
		  
//////////////////////////////////////////////////////////////////////////////////  	 
//函数类型：为其他函数服务的函数，不要显式调用
//函数描述：获得ADC值，参数可选：ADC_F2、ADC_R、ADC_L、ADC_F1、ADC_BATTARY 
//涉及全局变量：无
//////////////////////////////////////////////////////////////////////////////////
u16 Get_Adc(u8 ch)   
{
	//设置转换序列	  		 
	ADC1->SQR3&=0XFFFFFFE0;//规则序列1 通道ch
	ADC1->SQR3|=ch;		  			    
	ADC1->CR2|=1<<22;       //启动规则转换通道 
	while(!(ADC1->SR&1<<1));//等待转换结束	 	   
	return ADC1->DR;		//返回adc值	
}

u16 dataf1[250]={2990,2770,2576,2404,2250,2112,1987,1874,1772,1679,1593,1515,1443,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58,0};
u16 dataf2[250]={4333,3982,3675,3404,3163,2949,2757,2585,2429,2288,2159,2042,1935,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55,0};
u16 datal[250]={2827,2635,2464,2313,2177,2054,1943,1843,1751,1667,1590,1518,1453,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84,0};
u16 datar[250]={2241,2106,1986,1877,1779,1690,1609,1535,1467,1404,1345,1291,1241,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92,0};	//2015-20-22 工业大学

//////////////////////////////////////////////////////////////////////////////////
//函数类型：为其他函数服务的函数，不要显式调用
//函数描述：将ADC电压值转换为以mm为单位的距离值 
//涉及全局变量：无
//最后一个必须是零！！！
//////////////////////////////////////////////////////////////////////////////////
u16 FindDis(u16 ADC,u16 *data,u16 Length)
{
 	int tmp=0;
	if(ADC>data[0]) return 0;
	if(ADC<data[Length-2]) return Length-1;
	tmp=(Length-1)/2;
	Length/=2;
	while(1)
	{
		if(data[tmp]>ADC)
		{
			tmp+=Length/2; 
			if(Length%2==1)Length+=1; 
			Length/=2;
		}
		else if(data[tmp]<ADC)
		{
			tmp-=Length/2; 
			if(Length%2==1)Length+=1; 
			Length/=2;
		}
		else break;
		
		if(Length==1)break;
	}
	return tmp;
}



static long abovezero(long t)
{
	if(t>=0)return t;
	else return 0;
}


//////////////////////////////////////////////////////////////////////////////////  	 
//函数类型：公用函数
//函数描述：测量某方向的距离，包括F1 F2 L R几种参数可选
//涉及全局变量：无
//返回值：以mm为单位的距离
//表达式：r=10^((lg v-d)/c)
//严重bug！！查找数组会浪费大量时间！若不查数组，则4个传感器只需要25us即可完成，但查一个长度300表会多使用约7us，共查6个表测距总共花掉65us
//////////////////////////////////////////////////////////////////////////////////
double f1=2000.0,covf1=1.0,f1tmp,covf1tmp,kf1,Qf1=0.01,Pf1=0.2;//Q是系统噪声的cov(协方差)，P是测量噪声的cov.Q不变时，P越大，输出越稳定且反应迟钝。
double f2=2000.0,covf2=1.0,f2tmp,covf2tmp,kf2,Qf2=0.01,Pf2=0.2;
double l=2000.0,covl=1.0,ltmp,covltmp,kl,Ql=0.01,Pl=0.2;
double r=2000.0,covr=1.0,rtmp,covrtmp,kr,Qr=0.01,Pr=0.2;
u16 TempL,TempR;
extern long disf1,disf2,disf,disl,disr,disl45,disr45;
int rawf1,rawf2,rawl,rawr,rawf1h,rawf2h,rawlh,rawrh;
u8 kalmanswitch=1;
u8 biaodingmode=0;

void getdistance()
{
	delay_us(5);
	TempL=Get_Adc(ADC_LF);
	TempR=Get_Adc(ADC_RF);
	INFR_LF=1;INFR_RF=1;
	
	delay_us(60);
	TempL=abovezero(Get_Adc(ADC_LF)-TempL);
	TempR=abovezero(Get_Adc(ADC_RF)-TempR);
	INFR_LF=0;INFR_RF=0;
	
	if(kalmanswitch==1)
	{
		f1tmp=f1;
		covf1tmp=covf1+Qf1;
		kf1=covf1tmp/(covf1tmp+Pf1);
		f1=f1tmp+kf1*((double)TempL-f1tmp);
		covf1=(1-kf1)*covf1tmp;
		
		f2tmp=f2;
		covf2tmp=covf2+Qf2;
		kf2=covf2tmp/(covf2tmp+Pf2);
		f2=f2tmp+kf2*((double)TempR-f2tmp);
		covf2=(1-kf2)*covf2tmp;
	}
	else
	{
		f1=TempL;
		f2=TempR;
	}
//==============================
	TempL=Get_Adc(ADC_L);
	TempR=Get_Adc(ADC_R);
	INFR_L=1;INFR_R=1;
//==============================
	if(biaodingmode==0)
	{
		rawf1=f1;
		disf1=FindDis(abovezero((u16)f1),dataf1,250);
		
		rawf2=f2;
		disf2=FindDis(abovezero((u16)f2),dataf2,250);
	}
	else 
	{
		rawf1h=rawf1;
		rawf1=f1;
		rawf1=(rawf1*3+rawf1h*7)/10;
		
		rawf2h=rawf2;
		rawf2=f2;
		rawf2=(rawf2*3+rawf2h*7)/10;
	}
//=====================================================================================
	delay_us(55);
	TempL=abovezero(Get_Adc(ADC_L)-TempL);
	TempR=abovezero(Get_Adc(ADC_R)-TempR);
	INFR_L=0;INFR_R=0;

	if(kalmanswitch==1)
	{
		ltmp=l;
		covltmp=covl+Ql;
		kl=covltmp/(covltmp+Pl);
		l=ltmp+kl*((double)TempL-ltmp);
		covl=(1-kl)*covltmp;
		
		rtmp=r;
		covrtmp=covr+Qr;
		kr=covrtmp/(covrtmp+Pr);
		r=rtmp+kr*((double)TempR-rtmp);
		covr=(1-kr)*covrtmp;
	}
	else
	{
		l=TempL;
		r=TempR;
	}
	
	if(biaodingmode==0)
	{
		rawl=l;
		disl=FindDis(abovezero((u16)l),datal,250);
		
		rawr=r;
		disr=FindDis(abovezero((u16)r),datar,250);
	}
	else
	{
		rawlh=rawl;
		rawl=l;
		rawl=(rawl*3+rawlh*7)/10;
		
		rawrh=rawr;
		rawr=r;
		rawr=(rawr*3+rawrh*7)/10;
	}
}

double k,d;  

void ifRight(double logV1,double logV2,double logD1,double logD2)
{
	if(logD1==logD2||logV1==0||logV2==0||((logV1*logD2-logV2*logD1)==0))
	{
		LED1=1;LED2=1;LED3=1;LED4=1;LED5=1;LED6=1;LED7=1;LED8=1;
		while(1);      
	}
}


void CurveFit(double Y1,double X1,double Y2,double X2)
{
	d=(Y1*X2-Y2*X1)/(X2-X1);
	k=(Y1-d)/X1;
}


void CheckValue(u16 num,u16 infr[],u8 Name)
{
	u16 Vol,Dist; 
	u16 Dec_dist=0;
	double temp;
	switch(Name)
	{
		case F1:Dec_dist=20;break;
		case F2:Dec_dist=20;break;
		case L:Dec_dist=21;break;
		case R:Dec_dist=20;break;
		default:break;
	}
	for(Dist=0;Dist<(num-1);Dist++)
	{
		temp=k*log((double)(Dist+Dec_dist))+d;  
		Vol=exp(temp);
		infr[Dist]=(unsigned int)Vol;
	}
	infr[Dist]=0;
}


//vol:红外接受管到墙壁的实际ADC值;dist:红外接受管到墙壁的实际距离;infr:数组名字  logV=k*lodD+d
void InfCorrect(double vol1,double dist1,double vol2,double dist2,u16 num,u16 infr[],u8 Name)
{
	double logV1,logV2,logD1,logD2;
	logV1=log(vol1);
	logV2=log(vol2);
	logD1=log(dist1);
	logD2=log(dist2);   
	CurveFit(logV1,logD1,logV2,logD2);    
	CheckValue(num,infr,Name);
}




